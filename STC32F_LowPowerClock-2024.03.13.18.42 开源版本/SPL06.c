#include "IIC.h"
#include "SPL06.h"
#include "time.h"
#include "DATA.h"
#include "UART1.h"

extern u8 xdata DMABuffer[96];
extern u32 xdata JCQ06_00[10];
extern u16 Sleep_Queue_task[Sleep_queue_num];

u8 SPL06_C0R_DATA[18]= {0,0,0,0,0,0,0,0,0,0,0,0,0,0,0,0,0,0};//气压计校准数据


u16 c0 =0;
u16 c1 =0;

u32 c00 =0;
u32 c10 =0;

u16    c01 =0;
u16    c11 =0;

u16    c20 =0;
u16    c21 =0;

u16    c30 =0;


	
	
	
	
	

//========================================================================
// 函数: SPL06_Init()
// 描述: 初始化
// 参数:
// 返回:
// 版本: V1.0 2024.02.12
//========================================================================
void SPL06_Init()
{
    IIC_W2bit(SPL06_W,0x0C,0x09);//09初始化  80：从FIFO中读出所有数据后，写入'1'以清除所有旧数据。
    Sleep_delay_Time(20);
    IIC_W2bit(SPL06_W,0x08,0x00);//待机模式
    IIC_W2bit(SPL06_W,0x06,0x00);//配置气压采样
    IIC_W2bit(SPL06_W,0x07,0x00);//配置温度采样
    IIC_W2bit(SPL06_W,0x09,0x00);//
    Sleep_delay_Time(20);
    SPL06_C0R();
}




//========================================================================
// 函数: u16 ABS_12bit(u16 dat)
// 描述: 把12位数据转换为16位正数
// 参数: dat
// 返回: u16
// 版本: V1.0 2024.02.12
//========================================================================
u16 ABS_12bit(u16 dat)
{
    if(dat & 0x0800)
    {
        dat = (0x0fff - dat +1);
    }
    return dat;

}
//========================================================================
// 函数: u16 ABS_12bit(u16 dat)
// 描述: 把16位数据转换为16位正数
// 参数: dat
// 返回: u16
// 版本: V1.0 2024.02.12
//========================================================================
u16 ABS_16bit(u16 dat)
{
    if(dat & 0x8000)
    {
        dat = (0xffff - dat +1);
    }
    return dat;

}
//========================================================================
// 函数: u16 ABS_12bit(u16 dat)
// 描述: 把20位数据转换为32位正数
// 参数: dat
// 返回: u32
// 版本: V1.0 2024.02.12
//========================================================================
u32 ABS_20bit(u32 dat)
{
    if(dat & 0x00080000)
    {
        dat = (0x000fffff - dat +1);
    }
    return dat;

}


//========================================================================
// 函数: void SPL06_C0R()
// 描述: 读取传感器校准值
// 参数: 
// 返回:
// 版本: V1.0 2023.02.05
//========================================================================
void SPL06_C0R()
{
    u8 i = 0;
    Start(); //发送起始命令
    SendData(SPL06_W);                             //发送设备地址+写命令
    RecvACK();
    SendData(0x10);                             //发送设备地址+写命令
    RecvACK();
    delay_ms(1);
    Start(); //发送起始命令
    SendData(SPL06_R);                             //发送设备地址+写命令
    RecvACK();
    for(i=0; i<18; i++)
    {
        SPL06_C0R_DATA[i] = RecvData();
        if(i != 17) SendACK();
        else if(i == 17) SendNAK();
    }







    c0 = ((((u16)SPL06_C0R_DATA[0])<<8) |  SPL06_C0R_DATA[1])>>4;  //
    c0 = ABS_12bit(c0);

    c1 = ((((u16)SPL06_C0R_DATA[1])<<8) & 0x0f00) +  SPL06_C0R_DATA[2] ;  //
    c1 = ABS_12bit(c1);

    c00 = (((u32)SPL06_C0R_DATA[3])<<12) + (((u32)SPL06_C0R_DATA[4])<<4)+ (SPL06_C0R_DATA[5]>>4);
    c00 = ABS_20bit(c00);


    c10 = ((((u32)SPL06_C0R_DATA[5])<<16) & 0x000F0000)+ (((u32)SPL06_C0R_DATA[6])<<8)+ SPL06_C0R_DATA[7];
    c10 = ABS_20bit(c10);

    c01 = (((u16)SPL06_C0R_DATA[8])<<8) + SPL06_C0R_DATA[9];
    c01 =ABS_16bit(c01);

    c11 = (((u16)SPL06_C0R_DATA[10])<<8) + SPL06_C0R_DATA[11];
    c11 =ABS_16bit(c11);


    c20 = (((u16)SPL06_C0R_DATA[12])<<8) + SPL06_C0R_DATA[13];
    c20 =ABS_16bit(c20);

    c21 = (((u16)SPL06_C0R_DATA[14])<<8) + SPL06_C0R_DATA[15];
    c21 =ABS_16bit(c21);

    c30 = (((u16)SPL06_C0R_DATA[16])<<8) + SPL06_C0R_DATA[17];
    c30 =ABS_16bit(c30);
}


//========================================================================
// 函数: void SPL06_PR(u8 cmd,u8 dat)
// 描述: 0x01,0x00 气压，0x02,0x03 温度
// 参数: 
// 返回:
// 版本: V1.0 2023.02.05
//========================================================================
void SPL06_PR(u8 cmd,u8 dat)// 0x01,0x00 气压，0x02,0x03 温度
{
    u32 dat1 = 0;
    IIC_W2bit(SPL06_W,0x08,cmd);//测量温度
    delay_ms(6);
    Start(); //发送起始命令
    SendData(SPL06_W);                             //发送设备地址+写命令
    RecvACK();
    SendData(dat);                             //发送设备地址+写命令
    RecvACK();
    Start(); //发送起始命令
    SendData(SPL06_R);                             //发送设备地址+写命令
    RecvACK();

    dat1 = RecvData();                           //发送设备地址+写命令
    SendACK();
    dat1 = dat1<<8;
    dat1 += RecvData();                           //发送设备地址+写命令
    SendACK();
    dat1 = dat1<<8;
    dat1 += RecvData();                           //发送设备地址+写命令
    SendNAK();
    Stop();
    JCQ06_00[cmd+1] = dat1;
}

//========================================================================
// 函数: void SPL06_Math_P(u32 dat3,u32 dat2)
// 描述: 计算气压数据
// 参数: 
// 返回:
// 版本: V1.0 2023.02.05
//========================================================================
void SPL06_Math_P(u32 dat3,u32 dat2)//dat3气压
{
    u32 dat4;

    dat2 = (dat2<<12) / k_pt_1;
    dat3 = ((0x00ffffff - dat3 +1)<<12)/ k_pt_1;
    dat4 =c00 + ((dat3 *(c10 - ((dat3 *(c20 - ((dat3 * c30)>>12)))>>12)))>>12) - ((dat2 * c01)>>12) - ((((dat3 * dat2)>>2) * (c11 + ((dat3*c21)>>12)))>>22);
    JCQ06_00[4] = dat4;

}




//========================================================================
// 函数: void SPL06_R2(u8 cmd,u8 dat)
// 描述: 读取温度或气压原始数据
// 参数: 
// 返回:
// 版本: V1.0 2023.02.05
//========================================================================
void SPL06_R2(u8 cmd,u8 dat)
{
    u32 dat1 = 0;
    Start(); //发送起始命令
    SendData(SPL06_W);                             //发送设备地址+写命令
    RecvACK();
    SendData(dat);                             //发送设备地址+写命令
    RecvACK();
    Start(); //发送起始命令
    SendData(SPL06_R);                             //发送设备地址+写命令
    RecvACK();

    dat1 = RecvData();                           //发送设备地址+写命令
    SendACK();
    dat1 = dat1<<8;
    dat1 += RecvData();                           //发送设备地址+写命令
    SendACK();
    dat1 = dat1<<8;
    dat1 += RecvData();                           //发送设备地址+写命令
    SendNAK();
    Stop();
    JCQ06_00[cmd] = dat1;
}






//========================================================================
// 函数: void SPL06_PR_R()
// 描述: 测量温度（气压计）
// 参数: 
// 返回:
// 版本: V1.0 2023.02.05
//========================================================================
void SPL06_PR_R()
{
    IIC_W2bit(SPL06_W,0x08,0x02);//测量温度
    SleepQueue_aheadW1(15,0x0008,0);
}

//========================================================================
// 函数: void SPL06_PR_R_flag0008()
// 描述: 测量温度完成，读取温度数据，同时测量气压（气压计）
// 参数: 
// 返回:
// 版本: V1.0 2023.02.05
//========================================================================
void SPL06_PR_R_flag0008()
{

    if(Sleep_Queue_task[0] & 0x0008)
    {
        SPL06_R2(0x03,0x03);
        Sleep_Queue_task[0] &=~0x0008;
        IIC_W2bit(SPL06_W,0x08,0x01);//测量气压
        SleepQueue_aheadW1(15,0x0010,0);
    }
}
//========================================================================
// 函数: void SPL06_PR_P_flag0010()
// 描述: 测量气压完成，读取气压数据（气压计）
// 参数: 
// 返回:
// 版本: V1.0 2023.02.05
//========================================================================
void SPL06_PR_P_flag0010()
{
    if(Sleep_Queue_task[0] & 0x0010)
    {
        SPL06_R2(0x02,0x00);
        SPL06_Math_P(JCQ06_00[2],JCQ06_00[3]);
        Sleep_Queue_task[0] &=~0x0010;
    }
}


















