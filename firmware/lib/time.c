#include "time.h"


/****************************** 睡眠寄存器组 ***********************************/
extern u16 Sleep_Queue[Sleep_queue_num];


/****************************** 睡眠寄存器组 ***********************************/
extern u16 Sleep_Queue[Sleep_queue_num];

//========================================================================
// 函数: Timer0Init(void)
// 描述: 串口1定时器
// 参数: 
// 返回: 
// 版本: 
// 日期: 2013-4-1
// 备注:STC下载器自动生成
//========================================================================
void Timer0Init(void)		//1毫秒@35MHz
{
    AUXR |= 0x80;		//定时器时钟1T模式
    TMOD &= 0xF0;		//设置定时器模式
    TL0 = 0x48;		//设置定时初始值
    TH0 = 0x77;		//设置定时初始值
    TF0 = 0;		//清除TF0标志
    ET0 = 1;    //使能定时器中断
    TR0 = 1;		//定时器0开始计时
}



//========================================================================
// 函数: void delay_ms(u8 ms)
// 描述: 延时函数。
// 参数: ms,要延时的ms数, 这里只支持1~255ms. 自动适应主时钟.
// 返回: 
// 版本: 
// 日期: 2013-4-1
// 备注:STC例程提供
//========================================================================
void delay_ms(u8 ms)
{
    u16 i;
    do {
        i = MAIN_Fosc / 10000;
        while(--i);   //10T per loop
    } while(--ms);
}



//========================================================================
// 函数: Delay10us()
// 描述: 等待10us
// 参数: 
// 返回: 
// 版本: 
// 日期: 2013-4-1
// 备注:
//========================================================================
void Delay10us()		
{
    unsigned long i;

    _nop_();
    _nop_();
    _nop_();
    i = 173UL;
    while (i) i--;
}


//========================================================================
// 函数: void Sleep_delay_us(u8 ms)
// 描述: 掉电唤醒延时函数。
// 参数: ms
// 返回: none.
// 版本: VER1.0
// 日期: 2013-4-1
// 备注: 输入1约为0.5ms
//========================================================================
void Sleep_delay_HalfMs(u16 ms)
{
    if(ms <= 32767)
    {
        ms |= 0x8000;
        WKTCL = (ms | 0x0001);
        WKTCH = ms>>8;
    }
}







//========================================================================
// 函数: Sleep_delay_Time(u16 sleep_dat)
// 描述: 掉电休眠指定的时间，有重装填功能
// 参数: sleep_dat    1 ≈ 500us
// 返回: 
// 版本: 
// 日期: 2013-4-1
// 备注:
//========================================================================
void Sleep_delay_Time(u16 sleep_dat)
{
    u16 kk=0;
    u16 uu = 0;
	while(sleep_dat)											 //如果休眠时间不为0，说明被打断，继续休眠
    {
        Sleep_delay_HalfMs(sleep_dat);	 //设置休眠的值
        _nop_();
        _nop_();
        _nop_();
        _nop_();
        PD = 1;                            //MCU进入掉电模式
        _nop_();
        _nop_();
        _nop_();
        _nop_();
        WKTCH &= 0x7f;										//掉电唤醒寄存器停止计时
        kk = WKTCH;										    //读取掉电唤醒寄存器内的 已经休眠的多久的值
        kk = kk*256;
        kk = kk + WKTCL;
			  if(kk == 0)												//如果为0，说明已经按照任务休眠了足够的时间
        {
            sleep_dat = 0;
        }
        else
        {
					sleep_dat = sleep_dat - kk;   //如果不为0，说明休眠被打断，设定值 - 当前已经休眠了多久 = 还需要休眠多久
        }
    }
}







//========================================================================
// 函数: Sleep_Thread()
// 描述: 睡眠任务，当有休眠任务的时候，启动掉电唤醒寄存器，没有任务的话，进入休眠不再唤醒
// 参数: 
// 返回: 
// 版本: 
// 日期: 2013-4-1
// 备注:
//========================================================================

//void Sleep_Thread()
//{
//	if(RFF() > 0)//如果任务队列中，存在任务
//    {
//        Sleep_delay_Time(Sleep_Queue[0]);       //将任务需要等待的时间装填进掉电唤醒寄存器
//    }
//    else
//    {
//        WKTCH &= 0x7f;													//关闭掉电唤醒时钟


//        _nop_();
//        _nop_();
//        _nop_();
//        _nop_();
//        PCON = 0x02;                            //MCU进入掉电模式
//        _nop_();
//        _nop_();
//        _nop_();
//        _nop_();
//    }
//}



















